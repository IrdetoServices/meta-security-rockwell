## conf/distro/include/rockwell-testing.inc
```bitbake
# NB: set TEST_SUITES before including this file
# if testimage is enabled, then require'ing this file will add the meta-security-rockwell testimage tests to the suite

TEST_SUITES += "rockwell-mprotect"
IMAGE_INSTALL_append += " mprotect-test "
```

## conf/distro/include/rockwell.inc
```bitbake
INHERIT += " rockwell-isafw "
INHERIT += " rockwell-kconf_analyzer "

require conf/distro/include/security_flags.inc

#gdbserver looks to be broken on arm with PIE
SECURITY_CFLAGS_pn-gdbserver_arm = "${SECURITY_NO_PIE_CFLAGS}"

#libsigc++ breaks with the defautl SECURITY_CFLAGS on arm with PIE
SECURITY_CFLAGS_pn-libsigc++-2.0_arm = "${SECURITY_NO_PIE_CFLAGS}"

#cpufrequtils breaks with the default SECURITY_CFLAGS on arm with PIE
SECURITY_CFLAGS_pn-cpufrequtils_arm = "${SECURITY_NO_PIE_CFLAGS}"

#glibmm breaks with the default SECURITY_CFLAGS on arm with PIE
SECURITY_CFLAGS_pn-glibmm_arm = "${SECURITY_NO_PIE_CFLAGS}"

#python3 (many modules) breaks with the default SECURITY_CFLAGS on arm with PIE
SECURITY_CFLAGS_pn-python3-evdev_arm = "${SECURITY_NO_PIE_CFLAGS}"
SECURITY_CFLAGS_pn-python3-elementtree_arm = "${SECURITY_NO_PIE_CFLAGS}"
SECURITY_CFLAGS_pn-python3-subprocess_arm = "${SECURITY_NO_PIE_CFLAGS}"
SECURITY_CFLAGS_pn-python3-modules_arm = "${SECURITY_NO_PIE_CFLAGS}"
SECURITY_CFLAGS_pn-python3-xml_arm = "${SECURITY_NO_PIE_CFLAGS}"
```

## conf/layer.conf
```bitbake
BBPATH .= ":${LAYERDIR}"

BBFILES += "${LAYERDIR}/recipes-*/*/*.bb \
            ${LAYERDIR}/recipes-*/*/*.bbappend \
            ${LAYERDIR}/recipes-*/*.bb \
            ${LAYERDIR}/recipes-*/*.bbappend" 

BBFILE_COLLECTIONS += "security-rockwell"
BBFILE_PATTERN_security-rockwell = "^${LAYERDIR}/"
BBFILE_PRIORITY_security-rockwell = "5"
LAYERVERSION_security-rockwell = "1"

META_ROCKWELL_PATH = "${LAYERDIR}"
```
